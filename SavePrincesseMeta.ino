/***
 * Ce code est la pour faire une demonstration des possibiliter de la gamebuino meta de la facon la plus simple possible
 * le but est d avoir un code tres simple et bien documenter pour tout debutant
 * ce code n'est pas propre, et il y manque beaucoup de chose pour arriver a un logiciel digne de ce nom
 * le game play ne vaut rien 
 * 
 * pour aller plus loin :
 * + 1 fichier .ino par type d action 
 *    - un pour le monde
 *    - un pour le chevalier
 *    -un pour le mechant
 * + Separation du comportement et des graphisme  
 *    - chaque type d action a une methode update ou il y a la logique et une methode draw ou l on dessine le resultat
 * + gestion des etat de l application et ne plus avoir de while(true) pour chaquun dentre eux
 *    - menu principal
 *    - in game
 *    - game over
 *    
 * 
*/


#include <Gamebuino-Meta.h>

//image simple . le 0xFFFF correspond a la couleur transparente ici le blanc
const uint16_t MechantData[] = {16,16,1, 1, 0xFFFF, 0, 0xffff,0xffff,0xffff,0xffff,0xffff,0xffff,0xffff,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0xffff,0xd8e4};
Image Mechant = Image(MechantData);
const uint16_t Mechant1Data[] = {16,16,1, 1, 0xFFFF, 0, 0xffff,0xffff,0xffff,0xffff,0xffff,0xffff,0xffff,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0xffff,0xd8e4};
Image Mechant1 = Image(Mechant1Data);

//image simple
const uint16_t princeData[] = {16,16,1, 1, 0xFFFF, 0, 0xffff,0xffff,0xffff,0xffff,0xffff,0xffff,0xffff,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0xffff,0xffff};
Image prince = Image(princeData);
const uint16_t prince1Data[] = {16,16,1, 1, 0xFFFF, 0, 0xffff,0xffff,0xffff,0xffff,0xffff,0xffff,0xffff,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0xffff,0xffff};
Image prince1 = Image(prince1Data);


//80 : largeur de mon image
//64: hauteur de mon image
//2 : nombre de frame
//25 : je change toute les 25 frame donc toute les secondes
//0 : pas de transparence
//0 : image en rgb 565
//mon image converty par l utilitaire qui vas bien => https://gamebuino.com/fr/creations/png-to-code 
const uint16_t WorldSmallData[] = {80,64,2, 25, 0, 0, 0x7ddf,0x7ddf,0x7ddf,0x7ddf,0x7ddf,0x7ddf,0x7ddf,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0x44a,0x44a};
Image WorldSmall = Image(WorldSmallData);


//Position en X du chevalier
int xpos = 0;
//position en X du mechant
int xposMe = 0;
//si true le mechant a l'épee en mode attaque
bool attakMechant=false;

void initGame()
{
  //on met toutes les variable en position initiale
  xpos = 0;
  xposMe = 16;
  attakMechant=false;
}


//je fait un test entre 2 objet toujours de la meme taille et toujours sur la meme dimention donc je fait un test tres simple, savoir si la distance entre mes deux perso est inferieur a la largeur de mon price
//pour aller plus loin : https://openclassrooms.com/courses/theorie-des-collisions/formes-simples
bool collisionSimple()
{
  //le mechant aura toujours une postion en X plus grande que la mienne
  return (xposMe - xpos) < 16;
}

void setup()
{
  gb.begin();
  initGame();
}

/**
 *  en cas de victoir j arrive sur cette methode
 */
void victorie()
{
  //je boucle a l infini
  while(true)
  {
    if(gb.update()) // quand le framework est ok je passe a la suite
    {
      //clean de l ecran puis affichage du text
      gb.display.clear();
      gb.display.println("Youhou !");
      gb.display.print("appuis sur ");
      gb.display.print("A");
      if(gb.buttons.pressed(BUTTON_A)) //sur le bouton A appuye je sor de la boucle 
       {
         break;
       }

        //back light en vert :)
       gb.lights.fill(GREEN);
    }
  }
  initGame(); //on repart au debut du jeux
}

void loop(){
  
  //wait gamebuino next frame
  while(!gb.update());

  //clear display
  gb.display.clear();
  //clear back light
  gb.lights.clear();
    
      
    //on dessine le monde en position 0,0. le monde fait exatement la taille de l'ecran
    gb.display.drawImage(0,0,WorldSmall);

    //BUTTON_UP, BUTTON_RIGHT, BUTTON_DOWN, BUTTON_LEFT
     if(gb.buttons.repeat(BUTTON_RIGHT,1))
     {
       //si on appuis sur droite le chevalier va avancer de 1 px : xpos++
        if(!collisionSimple())//si je suis pas en collision avec le mechant
           xpos++;
     }
     else if  (gb.buttons.repeat(BUTTON_LEFT,1))
     {
       //je peut aussi reculer :0
       xpos--;
     }
     // on ne doit pas sortir de l'ecran
       if(xpos<0) xpos = 0;
       if(xpos>72) xpos = 64; // = 80 px de l'ecran de large - 16 px du chevalier. Faire la soustraction en code pour plus de souplesse 
       
     if(gb.buttons.repeat(BUTTON_A,1))
     {
       //le chevalier donne un coup d'epee
      gb.display.drawImage(xpos,48,prince1); //48 = 64 pixel de haut pour lecran - 16 du personnage
      gb.sound.playTick();
     }
     else 
     {
       //le chevalier ne donne pas de coup d'epee
      gb.display.drawImage(xpos,48,prince);
     }
     
     if(gb.buttons.pressed(BUTTON_A) && collisionSimple())
     {
        //flash jaune
         gb.lights.fill(YELLOW);
         //je touche le mechant recule de 4 px
         xposMe +=4;
         gb.sound.playOK();
     }
     
     //gestion du méchant 
     if(attakMechant)
     {
       //le mechant attaque 
        gb.display.drawImage(xposMe,48,Mechant1);
     }
     else 
     {
       //le mechant n'attaque pas
        gb.display.drawImage(xposMe,48,Mechant);
     }
     
     if(!collisionSimple())
     {
       //si le mechant le peux il avance vers le joueur
         xposMe--;
     }
     
     if(random(0,6)==0)//une chance sur 6 a chaque frame (25/ seconde de base)
     {
       // on change d'etat le mechant
       attakMechant = !attakMechant;
       if(attakMechant && collisionSimple())
       {
        //flash rouge
         gb.lights.fill(RED);
         //si il attaque et qu'il me touche ça fait mal je recule
         xpos -=4;//je recule de 4
         xposMe -=1;//le mechant avance de 1
         
         gb.sound.playOK();
       }
     }
     //SECURITE : le mechant ne peut pas aller derriere moi .
     if(xposMe<xpos)
     {
       xposMe = xpos+10;
     }
     
     //j'arrive au porte du chateau (pos>60) j'entre BUTTON_B
     if(xpos > 60 && gb.buttons.pressed(BUTTON_B))
     {
      victorie();//Et c'est gagner !
     }
    
}



